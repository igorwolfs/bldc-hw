## rev_1/fw/zephyr_ws/manifest/west.yml
```yaml
# my-repo/west.yml:
manifest:
  remotes:
    - name: zephyrproject-rtos
      url-base: https://github.com/zephyrproject-rtos
    - name: iw_remote
      url-base: https://github.com/igorwolfs/
  projects:
    - name: zephyr
      remote: zephyrproject-rtos
      revision: v3.6-branch
      import:
        # By using name-allowlist we can clone only the modules that are
        # strictly needed by the application.
        name-allowlist:
          - cmsis      # required by the ARM port
          - cmsis-dsp
          - hal_stm32  # required by the nucleo_f302r8 board (STM32 based)

    - name: zephyr-boards
      remote: iw_remote
      revision: main
      path: zephyr-boards
```
